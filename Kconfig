## Kconfig
```kconfig
menu "OneWireNg"

config PWR_CTRL_ENABLED
    bool "Strong pull-up via dedicated power switching transistor"
    default n

if PWR_CTRL_ENABLED
config PWR_CTRL_REV_POLARITY
    bool "Reverse polarity for GPIO controlling power switching transistor"
    default n
endif

config SEARCH_ENABLED
    bool "Enable 1-wire search"
    default y

if SEARCH_ENABLED
config MAX_SEARCH_FILTERS
    int "Max number of family codes for search filtering"
    default 10
    range 0 100
endif

config OVERDRIVE_ENABLED
    bool "Overdrive (high-speed) mode enabled"
    default n

choice CRC8_ALGO
    prompt "CRC-8/MAXIM calculation algorithm"
    default CRC8_ALGO_TAB_32

    config CRC8_ALGO_BASIC
        bool "Basic; no memory tables"
    config CRC8_ALGO_TAB_32
        bool "32 elements table"
    config CRC8_ALGO_TAB_16
        bool "16 elements table"
endchoice

config CRC16_ENABLED
    bool "Enable CRC-16/ARC"
    default n

if CRC16_ENABLED
choice CRC16_ALGO
    prompt "CRC-16/ALGO calculation algorithm"
    default CRC16_ALGO_TAB_32

    config CRC16_ALGO_BASIC
        bool "Basic; no memory tables"
    config CRC16_ALGO_TAB_32
        bool "32 elements table"
    config CRC16_ALGO_TAB_16
        bool "16 elements table"
endchoice
endif

config FLASH_CRC_TAB
    bool "Store CRC tables in flash memory"
    default n

config BUS_BLINK_PROTECTION
    bool "Data bus GPIO blink protection"
    default n

config BITBANG_DELAY_CCOUNT
    bool "Bit-banging timings using CPU cycles counter"
    default y

choice BITBANG_TIMING
    prompt "Bit-banging timing regime"
    default BITBANG_TIMING_STRICT

    config BITBANG_TIMING_STRICT
        bool "Strict"
    config BITBANG_TIMING_RELAXED
        bool "Relaxed"
    config BITBANG_TIMING_NULL
        bool "None"
endchoice

if SEARCH_ENABLED
config ITERATION_RETRIES
    int "Search scan iteration retires"
    default 0
    range 0 10
endif

config USE_NATIVE_CPP_NEW
    bool "Use native toolchain <new> header"
    default n

config DS18S20_EXT_RES
    bool "Extended temperature resolution for DS18S20"
    default n

config ESP8266_INIT_TIME
    int "ESP8266 init time in msecs"
    default 500
    range 0 10000

endmenu
```

## examples/esp-idf/DS2431/main/Kconfig.projbuild
```kconfig
menu "DS2431 example"

config OW_PIN
    int "1-wire pin number"
    default 13

config USE_OD_MODE
    bool "Use overdrive mode"
    default n

config WRITE_DEMO
    bool "Enable write to FLASH demo"
    default n

endmenu
```

## examples/esp-idf/DallasTemperature/main/Kconfig.projbuild
```kconfig
menu "DallasTemperature example"

config OW_PIN
    int "1-wire pin number"
    default 13

config PARASITE_POWER
    bool "Sensors powered parasitically"
    default n

if PARASITE_POWER
config PWR_OW_BUS
    bool "Power provided by 1-wire bus"
    default y

if !PWR_OW_BUS
config PWR_CTRL_PIN
    int "Pin number controlling power switching transistor"
    default 9
endif
endif

config SINGLE_SENSOR
    bool "Single sensor setup"
    default n
    help
        If set - only one sensor device is allowed to be connected to
        the bus. The library may be configured with 1-wire search activity
        disabled to reduce its footprint.

config SET_COMMON_RES
    bool "Set common resolution for connected sensors"
    default n

if SET_COMMON_RES
config COMMON_RES
    int "Common resolution (9-12 bits)"
    range 9 12
    default 12
endif

endmenu
```
